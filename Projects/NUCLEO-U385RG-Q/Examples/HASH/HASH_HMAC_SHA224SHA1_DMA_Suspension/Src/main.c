/* USER CODE BEGIN Header */
/**
  ******************************************************************************
  * @file    HASH/HASH_HMAC_SHA224SHA1_DMA_Suspension/Src/main.c
  * @author  MCD Application Team
  * @brief   This example describes how to use the RCC HAL API to configure the
  *          system clock (SYSCLK) and modify the clock settings on run time.
  ******************************************************************************
  * @attention
  *
  * Copyright (c) 2024 STMicroelectronics.
  * All rights reserved.
  *
  * This software is licensed under terms that can be found in the LICENSE file
  * in the root directory of this software component.
  * If no LICENSE file comes with this software, it is provided AS-IS.
  *
  ******************************************************************************
  */
/* USER CODE END Header */
/* Includes ------------------------------------------------------------------*/
#include "main.h"

/* Private includes ----------------------------------------------------------*/
/* USER CODE BEGIN Includes */

/* USER CODE END Includes */

/* Private typedef -----------------------------------------------------------*/
/* USER CODE BEGIN PTD */

/* USER CODE END PTD */

/* Private define ------------------------------------------------------------*/
/* USER CODE BEGIN PD */

/* USER CODE END PD */

/* Private macro -------------------------------------------------------------*/
/* USER CODE BEGIN PM */

/* USER CODE END PM */

/* Private variables ---------------------------------------------------------*/

DMA_HandleTypeDef handle_GPDMA1_Channel2;

HASH_HandleTypeDef hhash;
__ALIGN_BEGIN static const uint8_t pKeyHASH[3633] __ALIGN_END = {
                            0x54,0x68,0x65,0x20,0x48,0x41,0x53,0x48,0x20,0x73,
                            0x65,0x71,0x75,0x65,0x6e,0x74,0x69,0x61,0x6c,0x6c,
                            0x79,0x20,0x70,0x72,0x6f,0x63,0x65,0x73,0x73,0x65,
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                            0x20,0x31,0x2e};

/* USER CODE BEGIN PV */
/* Private variables ---------------------------------------------------------*/
/*
  "The hash processor is a fully compliant implementation of the secure
   hash algorithm (SHA-1), the MD5 (message-digest algorithm 5) hash
   algorithm and the HMAC (keyed-hash message authentication code)
   algorithm suitable for a variety of applications.*** STM32 ***"
*/

__ALIGN_BEGIN uint8_t pKeySmall[261] __ALIGN_END =
                        {0x54,0x68,0x65,0x20,0x68,0x61,0x73,0x68,
                         0x20,0x70,0x72,0x6f,0x63,0x65,0x73,0x73,
                         0x6f,0x72,0x20,0x69,0x73,0x20,0x61,0x20,
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                         0x32,0x20,0x2a,0x2a,0x2a};


__ALIGN_BEGIN uint8_t aInput_HighPrio[HIGH_PRIO_INPUT_TAB_SIZE] __ALIGN_END =
                        {0x54,0x68,0x65,0x20,0x68,0x61,0x73,0x68,
                         0x20,0x70,0x72,0x6f,0x63,0x65,0x73,0x73,
                         0x6f,0x72,0x20,0x69,0x73,0x20,0x61,0x20,
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                         0x32,0x20,0x2a,0x2a,0x2a};

/*
  "The hash processor is a fully compliant implementation of the secure hash algorithm
(SHA-1, SHA-224, SHA-256), the MD5 (message-digest algorithm 5) hash algorithm and
the HMAC (keyed-hash message authentication code) algorithm suitable for a variety of
applications. It computes a message digest (160 bits for the SHA-1 algorithm, 256 bits for
the SHA-256 algorithm and 224 bits for the SHA-224 algorithm,128 bits for the MD5
algorithm) for messages of up to (264 - 1) bits, while HMAC algorithm provide a way of
authenticating messages by means of hash functions. HMAC algorithm consist in calling
the SHA-1, SHA-224, SHA-256 or MD5 hash function twice.

The FIPS PUB 180-2 standard and the IETF RFC 1321 publication specify the SHA-1, SHA-
224 and SHA-256 and MD5 secure hash algorithms, respectively, for computing a
condensed representation of a message or data file. When a message of any length below
264 bits is provided on input, the SHA-1, SHA-224 and SHA-256 and MD5 produce
respective a 160-bit, 224 bit, 256 bit and 128-bit output string, respectively, called a
message digest. The message digest can then be processed with a digital signature
algorithm in order to generate or verify the signature for the message. Signing the message
digest rather than the message often improves the efficiency of the process because the
message digest is usually much smaller in size than the message. The verifier of a digital
signature has to use the same hash algorithm as the one used by the creator of the digital
signature.
The SHA-1, SHA-224 and SHA-256 and MD5 are qualified as "secure" because it is
computationally infeasible to find a message that corresponds to a given message digest, or
to find two different messages that produce the same message digest. Any change to a
message in transit will, with very high probability, result in a different message digest, and
the signature will fail to verify. For more detail on the SHA-1 or SHA-224 and SHA-256
algorithm, please refer to the FIPS PUB 180-2 (Federal Information Processing Standards
Publication 180-2), 2002 august 1.

The current implementation of this standard works with little-endian input data convention.
For example, the C string "abc" must be represented in memory as the 24-bit hexadecimal
value 0x434241.
A message or data file to be processed by the hash processor should be considered a bit
string. The length of the message is the number of bits in the message (the empty message
has length 0). You can consider that 32 bits of this bit string forms a 32-bit word. Note that
the FIPS PUB 180-1 standard uses the convention that bit strings grow from left to right, and
bits can be grouped as bytes (8 bits) or words (32 bits) (but some implementations also use
half-words (16 bits), and implicitly, uses the big-endian byte (half-word) ordering. This
convention is mainly important for padding.

Data are entered into the hash processor 32 bits (word) at a time, by writing them into the
HASH_DIN register. But the original bit-string can be organized in bytes, half-words or
words, or even be represented as bits. As the system memory organization is little-endian
and SHA1, SHA-224 and SHA-256 computation is big-endian, depending on the way the
original bit string is grouped, a bit, byte, or half-word swapping operation is performed
automatically by the hash processor.
The kind of data to be processed is configured with the DATATYPE bitfield in the HASH
control register (HASH_CR)."
*/

__ALIGN_BEGIN uint8_t aInput_LowPrio_Large[LOW_PRIO_LARGE_INPUT_TAB_SIZE] __ALIGN_END =
                        {0x54, 0x68, 0x65, 0x20, 0x68, 0x61, 0x73, 0x68, 0x20, 0x70, 0x72, 0x6f, 0x63, 0x65, 0x73, 0x73, 0x6f, 0x72, 0x20, 0x69,
                         0x73, 0x20, 0x61, 0x20, 0x66, 0x75, 0x6c, 0x6c, 0x79, 0x20, 0x63, 0x6f, 0x6d, 0x70, 0x6c, 0x69, 0x61, 0x6e, 0x74, 0x20,
                         0x69, 0x6d, 0x70, 0x6c, 0x65, 0x6d, 0x65, 0x6e, 0x74, 0x61, 0x74, 0x69, 0x6f, 0x6e, 0x20, 0x6f, 0x66, 0x20, 0x74, 0x68,
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                         0x53, 0x48, 0x5f, 0x43, 0x52, 0x29, 0x2e};

__ALIGN_BEGIN uint8_t aKey[KEY_TAB_SIZE] __ALIGN_END =
                        {0x54,0x68,0x65,0x20,0x68,0x61,0x73,0x68,
                         0x20,0x70,0x72,0x6f,0x63,0x65,0x73,0x73,
                         0x6f,0x72,0x20,0x69,0x73,0x20,0x61,0x20,
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                         0x32,0x20,0x2a,0x2a,0x2a};

__ALIGN_BEGIN static uint8_t aExpectSHA224Digest[SHA224_DIGEST_LENGTH] __ALIGN_END =
                        {0x4a, 0x6e, 0x86, 0xfc, 0x85, 0xdc, 0xe5, 0x35, 0xc6, 0x05, 0xe6, 0xbd, 0x9c, 0xda, 0x23,
                         0xbb, 0xc5, 0xc8, 0x96, 0xf8, 0x85, 0xd1, 0x22, 0x4d, 0x74, 0x60, 0xcd, 0x83};

__ALIGN_BEGIN static uint8_t aExpectSHA1Digest[SHA1_DIGEST_LENGTH] __ALIGN_END =
                        {0x2b, 0x47, 0xef, 0x34, 0xf6, 0x66, 0x58, 0xbe, 0x3b, 0x2a, 0xc6, 0xec, 0x58,
                         0x85, 0xf2, 0x1e, 0xd5, 0x9f, 0xdd, 0xad};

__ALIGN_BEGIN	static uint8_t aSHA1Digest[SHA1_DIGEST_LENGTH] __ALIGN_END;
__ALIGN_BEGIN	static uint8_t aSHA224Digest[SHA224_DIGEST_LENGTH] __ALIGN_END;

uint8_t Storage_Buffer[106 * 4] = {0};    /* 106 32-bit words are saved */
HASH_HandleTypeDef hhash_saved;  /* Handle to store low priority block
                                            HASH parameters during suspension */

/* USER CODE END PV */

/* Private function prototypes -----------------------------------------------*/
void SystemClock_Config(void);
static void MX_GPDMA1_Init(void);
static void MX_HASH_Init(void);
static void MX_ICACHE_Init(void);
static void MX_NVIC_Init(void);
/* USER CODE BEGIN PFP */
/* Private function prototypes -----------------------------------------------*/
static void HigherPriorityBlock_Management(void);
static void HigherPriorityBlock_DMA_Processing(void);

/* USER CODE END PFP */

/* Private user code ---------------------------------------------------------*/
/* USER CODE BEGIN 0 */

/* USER CODE END 0 */

/**
  * @brief  The application entry point.
  * @retval int
  */
int main(void)
{

  /* USER CODE BEGIN 1 */

  /* STM32U3xx HAL library initialization:
       - Configure the Flash prefetch
       - Configure the Systick to generate an interrupt each 1 msec
       - Set NVIC Group Priority to 3
       - Low Level Initialization
     */
  /* USER CODE END 1 */

  /* MCU Configuration--------------------------------------------------------*/

  /* Reset of all peripherals, Initializes the Flash interface and the Systick. */
  HAL_Init();

  /* USER CODE BEGIN Init */

  /* USER CODE END Init */

  /* Configure the system clock */
  SystemClock_Config();

  /* USER CODE BEGIN SysInit */

  /* USER CODE END SysInit */

  /* Initialize all configured peripherals */
  MX_GPDMA1_Init();
  MX_HASH_Init();
  MX_ICACHE_Init();

  /* Initialize interrupts */
  MX_NVIC_Init();
  /* USER CODE BEGIN 2 */
  MX_Queue_Config();
  /* */
  HAL_DMAEx_List_LinkQ(&handle_GPDMA1_Channel2, &Queue);
  /* Associate the DMA handle */
  __HAL_LINKDMA(&hhash, hdmain, handle_GPDMA1_Channel2);
  /* Configure LD2 */
  BSP_LED_Init(LD2);

  /****************************************************************************/
  /*                                                                          */
  /*       DMA-based HMAC SHA-224 processing suspension/resumption            */
  /*                                                                          */
  /****************************************************************************/
  size_t segment_sizes[SEGMENT_SIZES_COUNT] = {3000, 500, 67};
  size_t offset = 0;



  /********************************************************************/
  /*                                                                  */
  /* Start multi-buffer HMAC SHA-224 processing of low priority block */
  /*                                                                  */
  /********************************************************************/
  /* Compute HMAC */
  /* Set multiple DMA transfer feature */
  __HAL_HASH_SET_MDMAT();

  /* Loop to process each data segment */
  for (size_t i = 0; i < SEGMENT_SIZES_COUNT; i++) {
      /* Reset multiple DMA transfer feature before the last segment */
      if (i == SEGMENT_SIZES_COUNT - 1) {
          __HAL_HASH_RESET_MDMAT();
      }

      if (HAL_HASH_HMAC_Start_DMA(&hhash, &aInput_LowPrio_Large[offset], segment_sizes[i], aSHA224Digest) != HAL_OK) {
          Error_Handler();
      }

      /* Wait for the current segment processing to complete */
      while (HAL_HASH_GetState(&hhash) != HAL_HASH_STATE_READY);

      /* Update the offset for the next segment */
      offset += segment_sizes[i];
  }

  if(memcmp(aSHA224Digest, aExpectSHA224Digest ,28) != 0)
  {
    Error_Handler();
  }

  HAL_HASH_HMAC_Start_DMA(&hhash, aInput_LowPrio_Large, LOW_PRIO_LARGE_INPUT_TAB_SIZE, aSHA224Digest);

  /* For testing/debug purposes, request suspension now */
  HAL_HASH_ProcessSuspend(&hhash);

  while (HAL_HASH_GetState(&hhash) != HAL_HASH_STATE_SUSPENDED);

  /* The low-priority block processing is suspended, initiate
     the high-priority block processing */
  HigherPriorityBlock_Management();

  HAL_HASH_HMAC_Start_DMA(&hhash, aInput_LowPrio_Large, LOW_PRIO_LARGE_INPUT_TAB_SIZE, aSHA224Digest);


  /* Wait until processing is over */
  while (HAL_HASH_GetState(&hhash) != HAL_HASH_STATE_READY);

  /*******************/
  /* Read the digest */
  /*******************/
  if(memcmp(aSHA224Digest, aExpectSHA224Digest, SHA224_DIGEST_LENGTH) != 0)
  {
    Error_Handler();
  }
  else
  {
    BSP_LED_On(LD2);
  }
  /* USER CODE END 2 */

  /* Infinite loop */
  /* USER CODE BEGIN WHILE */
  while (1)
  {
    /* USER CODE END WHILE */

    /* USER CODE BEGIN 3 */

  }
  /* USER CODE END 3 */
}

/**
  * @brief System Clock Configuration
  * @retval None
  */
void SystemClock_Config(void)
{
  RCC_OscInitTypeDef RCC_OscInitStruct = {0};
  RCC_ClkInitTypeDef RCC_ClkInitStruct = {0};

  /** Enable Epod Booster
  */
  if (HAL_RCCEx_EpodBoosterClkConfig(RCC_EPODBOOSTER_SOURCE_MSIS, RCC_EPODBOOSTER_DIV1) != HAL_OK)
  {
    Error_Handler();
  }

  if (HAL_PWREx_EnableEpodBooster() != HAL_OK)
  {
    Error_Handler();
  }

  /** Configure the main internal regulator output voltage
  */
  if (HAL_PWREx_ControlVoltageScaling(PWR_REGULATOR_VOLTAGE_SCALE1) != HAL_OK)
  {
    Error_Handler();
  }

  /** Set Flash latency before increasing MSIS
  */
  __HAL_FLASH_SET_LATENCY(FLASH_LATENCY_2);

  /** Initializes the CPU, AHB and APB buses clocks
  */
  RCC_OscInitStruct.OscillatorType = RCC_OSCILLATORTYPE_MSIS;
  RCC_OscInitStruct.MSISState = RCC_MSI_ON;
  RCC_OscInitStruct.MSISSource = RCC_MSI_RC0;
  RCC_OscInitStruct.MSISDiv = RCC_MSI_DIV1;
  if (HAL_RCC_OscConfig(&RCC_OscInitStruct) != HAL_OK)
  {
    Error_Handler();
  }

  /** Initializes the CPU, AHB and APB buses clocks
  */
  RCC_ClkInitStruct.ClockType = RCC_CLOCKTYPE_HCLK|RCC_CLOCKTYPE_SYSCLK
                              |RCC_CLOCKTYPE_PCLK1|RCC_CLOCKTYPE_PCLK2
                              |RCC_CLOCKTYPE_PCLK3;
  RCC_ClkInitStruct.SYSCLKSource = RCC_SYSCLKSOURCE_MSIS;
  RCC_ClkInitStruct.AHBCLKDivider = RCC_SYSCLK_DIV1;
  RCC_ClkInitStruct.APB1CLKDivider = RCC_HCLK_DIV1;
  RCC_ClkInitStruct.APB2CLKDivider = RCC_HCLK_DIV1;
  RCC_ClkInitStruct.APB3CLKDivider = RCC_HCLK_DIV1;

  if (HAL_RCC_ClockConfig(&RCC_ClkInitStruct, FLASH_LATENCY_2) != HAL_OK)
  {
    Error_Handler();
  }
}

/**
  * @brief NVIC Configuration.
  * @retval None
  */
static void MX_NVIC_Init(void)
{
  /* GPDMA1_Channel2_IRQn interrupt configuration */
  HAL_NVIC_SetPriority(GPDMA1_Channel2_IRQn, 7, 0);
  HAL_NVIC_EnableIRQ(GPDMA1_Channel2_IRQn);
}

/**
  * @brief GPDMA1 Initialization Function
  * @param None
  * @retval None
  */
static void MX_GPDMA1_Init(void)
{

  /* USER CODE BEGIN GPDMA1_Init 0 */

  /* USER CODE END GPDMA1_Init 0 */

  /* Peripheral clock enable */
  __HAL_RCC_GPDMA1_CLK_ENABLE();

  /* USER CODE BEGIN GPDMA1_Init 1 */

  /* USER CODE END GPDMA1_Init 1 */
  handle_GPDMA1_Channel2.Instance = GPDMA1_Channel2;
  handle_GPDMA1_Channel2.InitLinkedList.Priority = DMA_LOW_PRIORITY_LOW_WEIGHT;
  handle_GPDMA1_Channel2.InitLinkedList.LinkStepMode = DMA_LSM_FULL_EXECUTION;
  handle_GPDMA1_Channel2.InitLinkedList.LinkAllocatedPort = DMA_LINK_ALLOCATED_PORT1;
  handle_GPDMA1_Channel2.InitLinkedList.TransferEventMode = DMA_TCEM_LAST_LL_ITEM_TRANSFER;
  handle_GPDMA1_Channel2.InitLinkedList.LinkedListMode = DMA_LINKEDLIST_NORMAL;
  if (HAL_DMAEx_List_Init(&handle_GPDMA1_Channel2) != HAL_OK)
  {
    Error_Handler();
  }
  if (HAL_DMA_ConfigChannelAttributes(&handle_GPDMA1_Channel2, DMA_CHANNEL_NPRIV) != HAL_OK)
  {
    Error_Handler();
  }
  /* USER CODE BEGIN GPDMA1_Init 2 */

  /* USER CODE END GPDMA1_Init 2 */

}

/**
  * @brief HASH Initialization Function
  * @param None
  * @retval None
  */
static void MX_HASH_Init(void)
{

  /* USER CODE BEGIN HASH_Init 0 */

  /* USER CODE END HASH_Init 0 */

  /* USER CODE BEGIN HASH_Init 1 */

  /* USER CODE END HASH_Init 1 */
  hhash.Instance = HASH;
  hhash.Init.DataType = HASH_BYTE_SWAP;
  hhash.Init.KeySize = 3633;
  hhash.Init.pKey = (uint8_t *)pKeyHASH;
  hhash.Init.Algorithm = HASH_ALGOSELECTION_SHA224;
  if (HAL_HASH_Init(&hhash) != HAL_OK)
  {
    Error_Handler();
  }
  /* USER CODE BEGIN HASH_Init 2 */

  /* USER CODE END HASH_Init 2 */

}

/**
  * @brief ICACHE Initialization Function
  * @param None
  * @retval None
  */
static void MX_ICACHE_Init(void)
{

  /* USER CODE BEGIN ICACHE_Init 0 */

  /* USER CODE END ICACHE_Init 0 */

  /* USER CODE BEGIN ICACHE_Init 1 */

  /* USER CODE END ICACHE_Init 1 */

  /** Enable instruction cache in 1-way (direct mapped cache)
  */
  if (HAL_ICACHE_ConfigAssociativityMode(ICACHE_1WAY) != HAL_OK)
  {
    Error_Handler();
  }
  if (HAL_ICACHE_Enable() != HAL_OK)
  {
    Error_Handler();
  }
  /* USER CODE BEGIN ICACHE_Init 2 */

  /* USER CODE END ICACHE_Init 2 */

}

/* USER CODE BEGIN 4 */

/**
  * @brief Computes high priority block HMAC SHA-1 digest.
  * @param  None
  * @retval None
  */
static void HigherPriorityBlock_DMA_Processing(void)
{

  /* hhash has been saved previously in hhash_saved.
     For the high priority block, all the initialization parameters are the
     same but the key */
  hhash.Init.Algorithm = HASH_ALGOSELECTION_SHA1;
  hhash.Init.pKey = (uint8_t *)pKeySmall;
  hhash.Init.KeySize = 261;
  if (HAL_HASH_Init(&hhash) != HAL_OK)
  {
    Error_Handler();
  }

  /* Computes HMAC SHA-1 digest */
  if (HAL_HASH_HMAC_Start_DMA(&hhash, aInput_HighPrio, HIGH_PRIO_INPUT_TAB_SIZE, aSHA1Digest))
  {
    Error_Handler();
  }
  /* Wait until processing is over */
  while (HAL_HASH_GetState(&hhash) == HAL_HASH_STATE_BUSY);

  return;
}

/**
  * @brief Once low priority block HMAC SHA-224 processing is suspended, save the HASH
  *        context, computes then checks the high priority block digest and finally
  *        restores the low priority block context.
  *        In the example at hand, the high priority block processing is HMAC SHA-1
  *        where data are fed to the IP in DMA mode.
  * @param  None
  * @retval None
  */
static void HigherPriorityBlock_Management(void)
{
      /* Context saving operation */
      HAL_HASH_Suspend(&hhash, Storage_Buffer);
      /* Save low-priority block HASH handle parameters */
      hhash_saved = hhash;

      /* Compute HMAC SHA-1 digest for the high priority block */
      HigherPriorityBlock_DMA_Processing();
      /* Check the computed result */
      if (memcmp(aSHA1Digest, aExpectSHA1Digest, SHA1_DIGEST_LENGTH) != 0)
      {
        Error_Handler();
      }

      /* Context restoring operation */
      HAL_HASH_Resume(&hhash, Storage_Buffer);
      hhash = hhash_saved;
}


/* USER CODE END 4 */

/**
  * @brief  This function is executed in case of error occurrence.
  * @retval None
  */
void Error_Handler(void)
{
  /* USER CODE BEGIN Error_Handler_Debug */
  /* User can add his own implementation to report the HAL error return state */
  while (1)
  {
    BSP_LED_Toggle(LD2);
    HAL_Delay(500);
  }
  /* USER CODE END Error_Handler_Debug */
}

#ifdef  USE_FULL_ASSERT
/**
  * @brief  Reports the name of the source file and the source line number
  *         where the assert_param error has occurred.
  * @param  file: pointer to the source file name
  * @param  line: assert_param error line source number
  * @retval None
  */
void assert_failed(uint8_t *file, uint32_t line)
{
  /* USER CODE BEGIN 6 */
  /* User can add his own implementation to report the file name and line number,
    ex: printf("Wrong parameters value: file %s on line %d\r\n", file, line) */

  /* Infinite loop */
  while (1)
  {
  }
  /* USER CODE END 6 */
}
#endif /* USE_FULL_ASSERT */
