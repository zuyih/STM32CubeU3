# file: HASH_SHA512.ioc
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CORTEX_M33_NS.userName=CORTEX_M33
HASH.Algorithm=HASH_ALGOSELECTION_SHA512
HASH.DataType=HASH_BYTE_SWAP
Mcu.Family=STM32U3
Mcu.Name=STM32U385RGTxQ
Mcu.Package=LQFP64
NVIC.PriorityGroup=NVIC_PRIORITYGROUP_4
ProjectManager.HeapSize=0x200
ProjectManager.StackSize=0x400
ProjectManager.TargetToolchain=EWARM V9.20
RCC.ADCFreq_Value=96000000
RCC.AHBFreq_Value=96000000
RCC.APB1Freq_Value=96000000
RCC.APB1TimFreq_Value=96000000
RCC.APB2Freq_Value=96000000
RCC.APB2TimFreq_Value=96000000
RCC.APB3Freq_Value=96000000
RCC.CortexFreq_Value=12000000
RCC.HCLKFreq_Value=96000000
RCC.HSE_VALUE=16000000
RCC.HSI48_VALUE=48000000
RCC.HSI_VALUE=16000000
RCC.LSE_VALUE=32768
RCC.LSIDIV_VALUE=32000
RCC.MSISDIV=RCC_MSI_DIV1
RCC.SYSCLKFreq_VALUE=96000000
RCC.USBFreq_Value=96000000
VP_HASH_VS_HASH.Mode=HASH_Activate
VP_ICACHE_VS_ICACHE.Mode=DirectMappedCache
VP_PWR_VS_DBSignals.Mode=DisableDeadBatterySignals
VP_PWR_VS_LPOM.Mode=PowerOptimisation
VP_PWR_VS_SECSignals.Mode=Security/Privilege
board=custom

// file: Src/main.c
/* USER CODE BEGIN Header */
/**
  ******************************************************************************
  * @file    HASH/HASH_SHA512/Src/main.c
  * @author  MCD Application Team
  * @brief   This sample code shows how to use the STM32U3xx HASH HAL API
  *          to get a HASH 512 digest value of a given buffer.
  ******************************************************************************
  * @attention
  *
  * Copyright (c) 2024 STMicroelectronics.
  * All rights reserved.
  *
  * This software is licensed under terms that can be found in the LICENSE file
  * in the root directory of this software component.
  * If no LICENSE file comes with this software, it is provided AS-IS.
  *
  ******************************************************************************
  */
/* USER CODE END Header */
#include "main.h"

HASH_HandleTypeDef hhash;

/* USER CODE BEGIN PV */

__ALIGN_BEGIN const uint8_t aInput[INPUT_TAB_SIZE] __ALIGN_END =
								{0x4f, 0x05, 0x60, 0x09, 0x50, 0x66, 0x4d, 0x51, 0x90, 0xa2,
                                 0xeb, 0xc2, 0x9c, 0x9e, 0xdb, 0x89, 0xc2, 0x00, 0x79, 0xa4,
                                 0xd3, 0xe6, 0xbc, 0x3b, 0x27, 0xd7, 0x5e, 0x34, 0xe2, 0xfa,
                                 0x3d, 0x02, 0x76, 0x85, 0x02, 0xbd, 0x69, 0x79, 0x00, 0x78,
                                 0x59, 0x8d, 0x5f, 0xcf, 0x3d, 0x67, 0x79, 0xbf, 0xed, 0x12,
                                 0x84, 0xbb, 0xe5, 0xad, 0x72, 0xfb, 0x45, 0x60, 0x15, 0x18,
                                 0x1d, 0x95, 0x87, 0xd6, 0xe8, 0x64, 0xc9, 0x40, 0x56, 0x4e,
                                 0xaa, 0xfb, 0x4f, 0x2f, 0xea, 0xd4, 0x34, 0x6e, 0xa0, 0x9b,
                                 0x68, 0x77, 0xd9, 0x34, 0x0f, 0x6b, 0x82, 0xeb, 0x15, 0x15,
                                 0x88, 0x08, 0x72, 0x21, 0x3d, 0xa3, 0xad, 0x88, 0xfe, 0xba,
                                 0x9f, 0x4f, 0x13, 0x81, 0x7a, 0x71, 0xd6, 0xf9, 0x0a, 0x1a,
                                 0x17, 0xc4, 0x3a, 0x15, 0xc0, 0x38, 0xd9, 0x88, 0xb5, 0xb2,
                                 0x9e, 0xdf, 0xfe, 0x2d, 0x6a, 0x06, 0x28, 0x13, 0xce, 0xdb,
                                 0xe8, 0x52, 0xcd, 0xe3, 0x02, 0xb3, 0xe3, 0x3b, 0x69, 0x68,
                                 0x46, 0xd2, 0xa8, 0xe3, 0x6b, 0xd6, 0x80, 0xef, 0xcc, 0x6c,
                                 0xd3, 0xf9, 0xe9, 0xa4, 0xc1, 0xae, 0x8c, 0xac, 0x10, 0xcc,
                                 0x52, 0x44, 0xd1, 0x31, 0x67, 0x71, 0x40, 0x39, 0x91, 0x76,
                                 0xed, 0x46, 0x70, 0x00, 0x19, 0xa0, 0x04, 0xa1, 0x63, 0x80,
                                 0x6f, 0x7f, 0xa4, 0x67, 0xfc, 0x4e, 0x17, 0xb4, 0x61, 0x7b,
                                 0xbd, 0x76, 0x41, 0xaa, 0xff, 0x7f, 0xf5, 0x63, 0x96, 0xba,
                                 0x8c, 0x08, 0xa8, 0xbe, 0x10, 0x0b, 0x33, 0xa2, 0x0b, 0x5d,
                                 0xaf, 0x13, 0x4a, 0x2a, 0xef, 0xa5, 0xe1, 0xc3, 0x49, 0x67,
                                 0x70, 0xdc, 0xf6, 0xba, 0xa4, 0xf7, 0xbb};

__ALIGN_BEGIN static uint8_t aSHA512Digest[64] __ALIGN_END;
__ALIGN_BEGIN static uint8_t aExpectSHA512Digest[64] __ALIGN_END =
								{0xa9, 0xdb, 0x49, 0x0c, 0x70, 0x8c, 0xc7, 0x25, 0x48, 0xd7,
                                 0x86, 0x35, 0xaa, 0x7d, 0xa7, 0x9b, 0xb2, 0x53, 0xf9, 0x45,
                                 0xd7, 0x10, 0xe5, 0xcb, 0x67, 0x7a, 0x47, 0x4e, 0xfc, 0x7c,
                                 0x65, 0xa2, 0xaa, 0xb4, 0x5b, 0xc7, 0xca, 0x11, 0x13, 0xc8,
                                 0xce, 0x0f, 0x3c, 0x32, 0xe1, 0x39, 0x9d, 0xe9, 0xc4, 0x59,
                                 0x53, 0x5e, 0x88, 0x16, 0x52, 0x1a, 0xb7, 0x14, 0xb2, 0xa6,
                                 0xcd, 0x20, 0x05, 0x25};;
/* USER CODE END PV */

void SystemClock_Config(void);
static void MX_HASH_Init(void);
static void MX_ICACHE_Init(void);

int main(void)
{

  /* USER CODE BEGIN 1 */

  /* STM32U3xx HAL library initialization:
       - Configure the Flash prefetch
       - Configure the Systick to generate an interrupt each 1 msec
       - Set NVIC Group Priority to 3
       - Low Level Initialization
     */
  /* USER CODE END 1 */

  /* MCU Configuration--------------------------------------------------------*/

  /* Reset of all peripherals, Initializes the Flash interface and the Systick. */
  HAL_Init();

  /* Configure the system clock */
  SystemClock_Config();

  /* Initialize all configured peripherals */
  MX_HASH_Init();
  MX_ICACHE_Init();
  /* USER CODE BEGIN 2 */
  /* Configure LD2 */
  BSP_LED_Init(LD2);

  /* Compute SHA512 */
  if (HAL_HASH_Start(&hhash, (uint8_t *)aInput, INPUT_TAB_SIZE, aSHA512Digest, 0xFF) != HAL_OK)
  {
    Error_Handler();
  }
  /* Compare computed digest with expected one */
  if (memcmp(aSHA512Digest, aExpectSHA512Digest, sizeof(aExpectSHA512Digest) / sizeof(aExpectSHA512Digest[0])) != 0)
  {
    Error_Handler();
  }
  else
  {
    BSP_LED_On(LD2);
  }

  /* USER CODE END 2 */

  /* Infinite loop */
  while (1)
  {

  }
}

void SystemClock_Config(void)
{
  RCC_OscInitTypeDef RCC_OscInitStruct = {0};
  RCC_ClkInitTypeDef RCC_ClkInitStruct = {0};

  /** Enable Epod Booster
  */
  if (HAL_RCCEx_EpodBoosterClkConfig(RCC_EPODBOOSTER_SOURCE_MSIS, RCC_EPODBOOSTER_DIV1) != HAL_OK)
  {
    Error_Handler();
  }

  if (HAL_PWREx_EnableEpodBooster() != HAL_OK)
  {
    Error_Handler();
  }

  /** Configure the main internal regulator output voltage
  */
  if (HAL_PWREx_ControlVoltageScaling(PWR_REGULATOR_VOLTAGE_SCALE1) != HAL_OK)
  {
    Error_Handler();
  }

  /** Set Flash latency before increasing MSIS
  */
  __HAL_FLASH_SET_LATENCY(FLASH_LATENCY_2);

  /** Initializes the CPU, AHB and APB buses clocks
  */
  RCC_OscInitStruct.OscillatorType = RCC_OSCILLATORTYPE_MSIS;
  RCC_OscInitStruct.MSISState = RCC_MSI_ON;
  RCC_OscInitStruct.MSISSource = RCC_MSI_RC0;
  RCC_OscInitStruct.MSISDiv = RCC_MSI_DIV1;
  if (HAL_RCC_OscConfig(&RCC_OscInitStruct) != HAL_OK)
  {
    Error_Handler();
  }

  /** Initializes the CPU, AHB and APB buses clocks
  */
  RCC_ClkInitStruct.ClockType = RCC_CLOCKTYPE_HCLK|RCC_CLOCKTYPE_SYSCLK
                              |RCC_CLOCKTYPE_PCLK1|RCC_CLOCKTYPE_PCLK2
                              |RCC_CLOCKTYPE_PCLK3;
  RCC_ClkInitStruct.SYSCLKSource = RCC_SYSCLKSOURCE_MSIS;
  RCC_ClkInitStruct.AHBCLKDivider = RCC_SYSCLK_DIV1;
  RCC_ClkInitStruct.APB1CLKDivider = RCC_HCLK_DIV1;
  RCC_ClkInitStruct.APB2CLKDivider = RCC_HCLK_DIV1;
  RCC_ClkInitStruct.APB3CLKDivider = RCC_HCLK_DIV1;

  if (HAL_RCC_ClockConfig(&RCC_ClkInitStruct, FLASH_LATENCY_2) != HAL_OK)
  {
    Error_Handler();
  }
}

static void MX_HASH_Init(void)
{

  hhash.Instance = HASH;
  hhash.Init.DataType = HASH_BYTE_SWAP;
  hhash.Init.Algorithm = HASH_ALGOSELECTION_SHA512;
  if (HAL_HASH_Init(&hhash) != HAL_OK)
  {
    Error_Handler();
  }

}

static void MX_ICACHE_Init(void)
{

  /** Enable instruction cache in 1-way (direct mapped cache)
  */
  if (HAL_ICACHE_ConfigAssociativityMode(ICACHE_1WAY) != HAL_OK)
  {
    Error_Handler();
  }
  if (HAL_ICACHE_Enable() != HAL_OK)
  {
    Error_Handler();
  }

}

void Error_Handler(void)
{
  /* USER CODE BEGIN Error_Handler_Debug */
  /* User can add his own implementation to report the HAL error return state */
  while (1)
  {
    /* Toggle LD2 with a period of 200 ms */
    BSP_LED_Toggle(LD2);
    HAL_Delay(200);
  }
  /* USER CODE END Error_Handler_Debug */
}
