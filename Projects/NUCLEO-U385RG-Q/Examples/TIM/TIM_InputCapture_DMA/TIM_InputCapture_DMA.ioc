# file: TIM_InputCapture_DMA.ioc
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CORTEX_M33_NS.userName=CORTEX_M33
GPDMA1.DESTDATAWIDTH_GPDMACH0=DMA_DEST_DATAWIDTH_WORD
GPDMA1.DESTINC_GPDMACH0=DMA_DINC_INCREMENTED
GPDMA1.IPHANDLE_GPDMACH0-SIMPLEREQUEST_GPDMACH0=__NULL
GPDMA1.REQUEST_GPDMACH0=GPDMA1_REQUEST_TIM16_CH1
GPDMA1.SRCDATAWIDTH_GPDMACH0=DMA_SRC_DATAWIDTH_WORD
GPDMA1.TRANSFERALLOCATEDPORTDEST_GPDMACH0=DMA_DEST_ALLOCATED_PORT1
Mcu.Family=STM32U3
Mcu.Name=STM32U385RGTxQ
Mcu.Package=LQFP64
NVIC.GPDMA1_Channel0_IRQn=true\:0\:0\:false\:false\:true\:false\:true\:true
NVIC.PriorityGroup=NVIC_PRIORITYGROUP_4
PA8.Mode=Clock-out-1
PA8.Signal=RCC_MCO
ProjectManager.HeapSize=0x200
ProjectManager.StackSize=0x400
ProjectManager.TargetToolchain=EWARM V9.20
RCC.ADCFreq_Value=96000000
RCC.AHBFreq_Value=96000000
RCC.APB1Freq_Value=96000000
RCC.APB1TimFreq_Value=96000000
RCC.APB2CLKDivider=RCC_HCLK_DIV2
RCC.APB2Freq_Value=48000000
RCC.APB2TimFreq_Value=96000000
RCC.APB3Freq_Value=96000000
RCC.CortexFreq_Value=12000000
RCC.HCLKFreq_Value=96000000
RCC.HSE_VALUE=16000000
RCC.HSI48_VALUE=48000000
RCC.HSI_VALUE=16000000
RCC.LSE_VALUE=32768
RCC.LSIDIV_VALUE=32000
RCC.MSISDIV=RCC_MSI_DIV1
RCC.RCC_MCO1Source=RCC_MCO1SOURCE_LSI
RCC.RCC_MCO2Source=RCC_MCO2SOURCE_LSI
RCC.SYSCLKFreq_VALUE=96000000
RCC.USBFreq_Value=96000000
TIM16.Channel=TIM_CHANNEL_1
TIM16.TIM16_TI1_REMAP=TIM_TIM16_TI1_MCO
VP_GPDMA1_VS_GPDMACH0.Mode=SIMPLEREQUEST_GPDMACH0
VP_ICACHE_VS_ICACHE.Mode=DirectMappedCache
VP_PWR_VS_DBSignals.Mode=DisableDeadBatterySignals
VP_PWR_VS_LPOM.Mode=PowerOptimisation
VP_PWR_VS_SECSignals.Mode=Security/Privilege
VP_TIM16_VS_ClockSourceINT.Mode=Enable_Timer
VP_TIM16_VS_NoInput1.Mode=Input_Capture1_from_TI1_REMAP_TIM16
board=custom

// file: Src/main.c
/* USER CODE BEGIN Header */
/**
  ******************************************************************************
  * @file           : main.c
  * @brief          : Main program body
  ******************************************************************************
  * @attention
  *
  * Copyright (c) 2024 STMicroelectronics.
  * All rights reserved.
  *
  * This software is licensed under terms that can be found in the LICENSE file
  * in the root directory of this software component.
  * If no LICENSE file comes with this software, it is provided AS-IS.
  *
  ******************************************************************************
  */
/* USER CODE END Header */
#include "main.h"

/* USER CODE BEGIN Includes */
#include <string.h>
/* USER CODE END Includes */

TIM_HandleTypeDef htim16;
DMA_HandleTypeDef handle_GPDMA1_Channel0;

/* USER CODE BEGIN PV */
uint32_t aDST_Buffer[BUFFER_SIZE] __attribute__((section("noncacheable_buffer")));

/* DMA transfer result flags */
__IO uint32_t TransferCompleteDetected = 0U;
__IO uint32_t TransferErrorDetected = 0U;

uint32_t uwMinFrequency = 0;
uint32_t uwMaxFrequency = 0;
uint32_t uwAvgFrequency = 0;
uint32_t TimerClock = 0;
/* USER CODE END PV */

void SystemClock_Config(void);
static void MX_GPIO_Init(void);
static void MX_GPDMA1_Init(void);
static void MX_TIM16_Init(void);
static void MX_ICACHE_Init(void);
/* USER CODE BEGIN PFP */
void ClockConfig(void);
uint32_t GetTimerCLKFreq(void);
/* USER CODE END PFP */

int main(void)
{

  /* USER CODE BEGIN 1 */
  uint32_t cnt_diff = 0;
  uint32_t cnt_min = 0;
  uint32_t cnt_max = 0;
  uint32_t cnt_avg = 0;

  /* USER CODE END 1 */

  /* MCU Configuration--------------------------------------------------------*/

  /* Reset of all peripherals, Initializes the Flash interface and the Systick. */
  HAL_Init();

  /* Configure the system clock */
  SystemClock_Config();

  /* USER CODE BEGIN SysInit */
  /* LSI clock and MCO2 configuration */
  ClockConfig();

  /* Initialize LD2 */
  BSP_LED_Init(LD2);
  /* USER CODE END SysInit */

  /* Initialize all configured peripherals */
  MX_GPIO_Init();
  MX_GPDMA1_Init();
  MX_TIM16_Init();
  MX_ICACHE_Init();
  /* USER CODE BEGIN 2 */
  /* Clear the DMA buffer */
  memset(aDST_Buffer, 0, sizeof(aDST_Buffer));

  /* Start the DMA transfer and the Timer 15 */
  HAL_TIM_IC_Start_DMA(&htim16, TIM_CHANNEL_1, aDST_Buffer, BUFFER_SIZE*4);

  /* Wait for end of transmission or an error occurred */
  while ((TransferCompleteDetected == 0) && (TransferErrorDetected == 0U));

  if (TransferCompleteDetected == 1)
  {
    /* Get the TIM16 clock frequency */
    TimerClock = GetTimerCLKFreq();

    /* Calculation of max, min & avg period values of the input signal with the buffer */
    for (uint8_t i = 0 ; i<BUFFER_SIZE-1 ; i++)
    {
      /* In case of the next value is smaller than the current one,
         it means that the counter restarted after reaching the Autoreload value.
         So the difference is made with the ARR value */
      cnt_diff = aDST_Buffer[i+1] > aDST_Buffer[i] ? \
                 aDST_Buffer[i+1] - aDST_Buffer[i] : \
                 ((uint32_t)__HAL_TIM_GET_AUTORELOAD(&htim16) - aDST_Buffer[i]) + aDST_Buffer[i+1] + 1;

      /* Load the first value as it is the maximum, otherwise take the value if it is higher */
      cnt_max = cnt_diff > cnt_max || i == 0 ? cnt_diff : cnt_max;

      /* Load the first value as it is the minimum, otherwise take the value if it is lower */
      cnt_min = cnt_diff < cnt_min || i == 0 ? cnt_diff : cnt_min;

      /* Add the differences for average calculation */
      cnt_avg += cnt_diff;
    }
    /* Average calculation */
    cnt_avg = cnt_avg / (BUFFER_SIZE-1);

    /* Reshaping the values in frequency from Timer clock */
    uwMaxFrequency = TimerClock / cnt_min;
    uwMinFrequency = TimerClock / cnt_max;
    uwAvgFrequency = TimerClock / cnt_avg;

    /* Check if the average value is close to the LSI theoretical value */
    if ((uwAvgFrequency > (LSI_VALUE * MIN_TOLERANCE)) && (uwAvgFrequency < (LSI_VALUE * MAX_TOLERANCE)))
    {
      /* Green Led, right frequency result value */
      BSP_LED_On(LD2);
    }
    TransferCompleteDetected = 0U;
  }
  else
  {
    TransferErrorDetected = 0U;
  }
  /* USER CODE END 2 */

  /* Infinite loop */
  while (1)
  {

  }
}

void SystemClock_Config(void)
{
  RCC_OscInitTypeDef RCC_OscInitStruct = {0};
  RCC_ClkInitTypeDef RCC_ClkInitStruct = {0};

  /** Enable Epod Booster
  */
  if (HAL_RCCEx_EpodBoosterClkConfig(RCC_EPODBOOSTER_SOURCE_MSIS, RCC_EPODBOOSTER_DIV1) != HAL_OK)
  {
    Error_Handler();
  }

  if (HAL_PWREx_EnableEpodBooster() != HAL_OK)
  {
    Error_Handler();
  }

  /** Configure the main internal regulator output voltage
  */
  if (HAL_PWREx_ControlVoltageScaling(PWR_REGULATOR_VOLTAGE_SCALE1) != HAL_OK)
  {
    Error_Handler();
  }

  /** Set Flash latency before increasing MSIS
  */
  __HAL_FLASH_SET_LATENCY(FLASH_LATENCY_2);

  /** Initializes the CPU, AHB and APB buses clocks
  */
  RCC_OscInitStruct.OscillatorType = RCC_OSCILLATORTYPE_LSI|RCC_OSCILLATORTYPE_MSIS;
  RCC_OscInitStruct.LSIState = RCC_LSI_ON;
  RCC_OscInitStruct.LSIDiv = RCC_LSI_DIV1;
  RCC_OscInitStruct.MSISState = RCC_MSI_ON;
  RCC_OscInitStruct.MSISSource = RCC_MSI_RC0;
  RCC_OscInitStruct.MSISDiv = RCC_MSI_DIV1;
  if (HAL_RCC_OscConfig(&RCC_OscInitStruct) != HAL_OK)
  {
    Error_Handler();
  }

  /** Initializes the CPU, AHB and APB buses clocks
  */
  RCC_ClkInitStruct.ClockType = RCC_CLOCKTYPE_HCLK|RCC_CLOCKTYPE_SYSCLK
                              |RCC_CLOCKTYPE_PCLK1|RCC_CLOCKTYPE_PCLK2
                              |RCC_CLOCKTYPE_PCLK3;
  RCC_ClkInitStruct.SYSCLKSource = RCC_SYSCLKSOURCE_MSIS;
  RCC_ClkInitStruct.AHBCLKDivider = RCC_SYSCLK_DIV1;
  RCC_ClkInitStruct.APB1CLKDivider = RCC_HCLK_DIV1;
  RCC_ClkInitStruct.APB2CLKDivider = RCC_HCLK_DIV2;
  RCC_ClkInitStruct.APB3CLKDivider = RCC_HCLK_DIV1;

  if (HAL_RCC_ClockConfig(&RCC_ClkInitStruct, FLASH_LATENCY_2) != HAL_OK)
  {
    Error_Handler();
  }

  /** MCO1 configuration
  */
  HAL_RCC_MCOConfig(RCC_MCO1, RCC_MCO1SOURCE_LSI, RCC_MCODIV_1);
}

static void MX_GPDMA1_Init(void)
{

  /* Peripheral clock enable */
  __HAL_RCC_GPDMA1_CLK_ENABLE();

  /* GPDMA1 interrupt Init */
    HAL_NVIC_SetPriority(GPDMA1_Channel0_IRQn, 0, 0);
    HAL_NVIC_EnableIRQ(GPDMA1_Channel0_IRQn);

}

static void MX_ICACHE_Init(void)
{

  /** Enable instruction cache in 1-way (direct mapped cache)
  */
  if (HAL_ICACHE_ConfigAssociativityMode(ICACHE_1WAY) != HAL_OK)
  {
    Error_Handler();
  }
  if (HAL_ICACHE_Enable() != HAL_OK)
  {
    Error_Handler();
  }

}

static void MX_TIM16_Init(void)
{

  TIM_IC_InitTypeDef sConfigIC = {0};

  htim16.Instance = TIM16;
  htim16.Init.Prescaler = 0;
  htim16.Init.CounterMode = TIM_COUNTERMODE_UP;
  htim16.Init.Period = 65535;
  htim16.Init.ClockDivision = TIM_CLOCKDIVISION_DIV1;
  htim16.Init.RepetitionCounter = 0;
  htim16.Init.AutoReloadPreload = TIM_AUTORELOAD_PRELOAD_DISABLE;
  if (HAL_TIM_Base_Init(&htim16) != HAL_OK)
  {
    Error_Handler();
  }
  if (HAL_TIM_IC_Init(&htim16) != HAL_OK)
  {
    Error_Handler();
  }
  sConfigIC.ICPolarity = TIM_INPUTCHANNELPOLARITY_RISING;
  sConfigIC.ICSelection = TIM_ICSELECTION_DIRECTTI;
  sConfigIC.ICPrescaler = TIM_ICPSC_DIV1;
  sConfigIC.ICFilter = 0;
  if (HAL_TIM_IC_ConfigChannel(&htim16, &sConfigIC, TIM_CHANNEL_1) != HAL_OK)
  {
    Error_Handler();
  }
  if (HAL_TIMEx_TISelection(&htim16, TIM_TIM16_TI1_MCO, TIM_CHANNEL_1) != HAL_OK)
  {
    Error_Handler();
  }

}

static void MX_GPIO_Init(void)
{
  GPIO_InitTypeDef GPIO_InitStruct = {0};

  /* GPIO Ports Clock Enable */
  __HAL_RCC_GPIOA_CLK_ENABLE();

  /*Configure GPIO pin : PA8 */
  GPIO_InitStruct.Pin = GPIO_PIN_8;
  GPIO_InitStruct.Mode = GPIO_MODE_AF_PP;
  GPIO_InitStruct.Pull = GPIO_NOPULL;
  GPIO_InitStruct.Speed = GPIO_SPEED_FREQ_HIGH;
  GPIO_InitStruct.Alternate = GPIO_AF0_MCO;
  HAL_GPIO_Init(GPIOA, &GPIO_InitStruct);

}

/* USER CODE BEGIN 4 */
/**
  * @brief Configure the LSI clock to redirect to MCO2
  * @param None
  * @retval None
  */
void ClockConfig(void)
{
  RCC_OscInitTypeDef RCC_OscInitStruct = {0};

  /* Activate the LSI */
  RCC_OscInitStruct.OscillatorType = RCC_OSCILLATORTYPE_LSI;
  RCC_OscInitStruct.LSIState = RCC_LSI_ON;
  HAL_RCC_OscConfig(&RCC_OscInitStruct);

  /* LSI clock redirected to MCO2 */
  HAL_RCC_MCOConfig(RCC_MCO2, RCC_MCO2SOURCE_LSI, RCC_MCODIV_1);
}

/**
  * @brief Compute the TIM16 clock frequency.
  * @param None
  * @retval Timer clock frequency
  */
uint32_t GetTimerCLKFreq(void)
{
  uint32_t timer_clock_freq = 0;                      /* Timer clock frequency result */
  RCC_ClkInitTypeDef clock_config = {0};              /* Temporary variable to retrieve RCC clock configuration */
  uint32_t latency;                                   /* Temporary variable to retrieve Flash Latency */
  RCC_PeriphCLKInitTypeDef periph_clock_config = {0}; /* Temporary variable to retrieve RCC configuration information for Extended peripherals clocks */

  /* Retrieve RCC clock configuration */
  HAL_RCC_GetClockConfig(&clock_config, &latency);
  /* Retrieve RCC configuration information */
  HAL_RCCEx_GetPeriphCLKConfig(&periph_clock_config);
  UNUSED(latency); /* To avoid compilation warning */

  if (clock_config.APB2CLKDivider < RCC_HCLK_DIV2)
  {
    /* If APBx prescaler (PPREx) is lower than RCC_HCLK_DIV2, then TIMclock is equal to APBx clock */
    timer_clock_freq = HAL_RCC_GetPCLK2Freq();
  }
  else if ((clock_config.APB2CLKDivider >= RCC_HCLK_DIV2) && (periph_clock_config.TimIcClockSelection == RCC_TIMICCLKSOURCE_DISABLE))
  {
    /* If APBx prescaler (PPREx) is higher or equal than RCC_HCLK_DIV2 and Timers clocks selection (TIMCS)
       is equal to 0, then TIMclock is twice APBx clock */
    timer_clock_freq = HAL_RCC_GetPCLK2Freq() * 2;
  }
  else
  {
    /* If APBx prescaler (PPREx) is higher or equal than RCC_HCLK_DIV2 and Timers clocks selection (TIMCS)
       is equal to 1, then TIMclock is 4 times the APBx clock */
    timer_clock_freq = HAL_RCC_GetPCLK2Freq() * 4;
  }

  return timer_clock_freq;
}

/**
  * @brief  Input Capture callback in non-blocking mode
  * @param  htim TIM handle
  * @retval None
  */
void HAL_TIM_IC_CaptureCallback(TIM_HandleTypeDef *htim)
{
  TransferCompleteDetected = 1U;
}

/**
  * @brief  Timer error callback in non-blocking mode
  * @param  htim TIM handle
  * @retval None
  */
void HAL_TIM_ErrorCallback(TIM_HandleTypeDef *htim)
{
  TransferErrorDetected = 1U;
}
/* USER CODE END 4 */

void Error_Handler(void)
{
  __disable_irq();
  while(1)
  {
  }
}
