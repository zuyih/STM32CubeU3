# file: DMA_DataHandling.ioc
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CORTEX_M33_NS.userName=CORTEX_M33
GPDMA1.DESTDATAWIDTH_GPDMACH0=DMA_DEST_DATAWIDTH_HALFWORD
GPDMA1.DESTINC_GPDMACH0=DMA_DINC_INCREMENTED
GPDMA1.PRIORITY_GPDMACH0=DMA_LOW_PRIORITY_HIGH_WEIGHT
GPDMA1.SRCINC_GPDMACH0=DMA_SINC_INCREMENTED
GPDMA1.TRANSFERALLOCATEDPORTDEST_GPDMACH0=DMA_DEST_ALLOCATED_PORT1
Mcu.Family=STM32U3
Mcu.Name=STM32U385RGTxQ
Mcu.Package=LQFP64
NVIC.GPDMA1_Channel0_IRQn=true\:0\:0\:false\:false\:true\:true\:true\:true
NVIC.PriorityGroup=NVIC_PRIORITYGROUP_4
ProjectManager.HeapSize=0x200
ProjectManager.StackSize=0x400
ProjectManager.TargetToolchain=EWARM V9.20
RCC.ADCFreq_Value=96000000
RCC.AHBFreq_Value=96000000
RCC.APB1Freq_Value=96000000
RCC.APB1TimFreq_Value=96000000
RCC.APB2Freq_Value=96000000
RCC.APB2TimFreq_Value=96000000
RCC.APB3Freq_Value=96000000
RCC.CortexFreq_Value=12000000
RCC.HCLKFreq_Value=96000000
RCC.HSE_VALUE=16000000
RCC.HSI48_VALUE=48000000
RCC.HSI_VALUE=16000000
RCC.LSE_VALUE=32768
RCC.LSIDIV_VALUE=32000
RCC.MSISDIV=RCC_MSI_DIV1
RCC.SYSCLKFreq_VALUE=96000000
RCC.USBFreq_Value=96000000
VP_GPDMA1_VS_GPDMACH0.Mode=SIMPLEREQUEST_GPDMACH0
VP_ICACHE_VS_ICACHE.Mode=DirectMappedCache
VP_PWR_VS_DBSignals.Mode=DisableDeadBatterySignals
VP_PWR_VS_LPOM.Mode=PowerOptimisation
VP_PWR_VS_SECSignals.Mode=Security/Privilege
board=custom

// file: Src/main.c
/* USER CODE BEGIN Header */
/**
  ******************************************************************************
  * @file           : main.c
  * @brief          : Main program body
  ******************************************************************************
  * @attention
  *
  * Copyright (c) 2024 STMicroelectronics.
  * All rights reserved.
  *
  * This software is licensed under terms that can be found in the LICENSE file
  * in the root directory of this software component.
  * If no LICENSE file comes with this software, it is provided AS-IS.
  *
  ******************************************************************************
  */
/* USER CODE END Header */
#include "main.h"

/* USER CODE BEGIN Includes */
#include <string.h>
/* USER CODE END Includes */

/* USER CODE BEGIN PD */
#define BUFFER_SIZE 8U

/* DMA flags declaration */
__IO uint32_t TransferCompleteDetected = 0U, TransferErrorDetected = 0U;

/* Source buffer */
static const uint8_t aSRC_Buffer[BUFFER_SIZE] = {0xB0, 0xB1, 0xB2, 0xB3, 0xB4, 0xB5, 0xB6, 0xB7};

/* Destination buffer */
static uint8_t aDEST_Buffer[BUFFER_SIZE * 2U];

/* Right aligned zero padding data expected result buffer */
static const uint8_t aRightAlign_ZeroPadding_ExpectedResult_Buffer[BUFFER_SIZE * 2U] = {0xB0, 0x00, 0xB1, 0x00, 0xB2, 0x00, 0xB3, 0x00, 0xB4, 0x00, 0xB5, 0x00, 0xB6, 0x00, 0xB7, 0x00};

/* Right aligned sign extend data expected result buffer */
static const uint8_t aRightAlign_SignExtend_ExpectedResult_Buffer[BUFFER_SIZE * 2U]  = {0xB0, 0xFF, 0xB1, 0xFF, 0xB2, 0xFF, 0xB3, 0xFF, 0xB4, 0xFF, 0xB5, 0xFF, 0xB6, 0xFF, 0xB7, 0xFF};

/* Right aligned left truncated data expected result buffer */
static const uint8_t aRightAlign_LeftTrunc_ExpectedResult_Buffer[BUFFER_SIZE]   = {0xB0, 0xB2, 0xB4, 0xB6, 0x00, 0x00, 0x00, 0x00};

/* Left aligned right truncated data expected result buffer */
static const uint8_t aLeftAlign_RightTrunc_ExpectedResult_Buffer[BUFFER_SIZE]   = {0xB1, 0xB3, 0xB5, 0xB7, 0x00, 0x00, 0x00, 0x00};

/* Source byte exchange data expected result buffer */
static const uint8_t aSrcByte_Exchange_ExpectedResult_Buffer[BUFFER_SIZE]       = {0xB0, 0xB2, 0xB1, 0xB3, 0xB4, 0xB6, 0xB5, 0xB7};

/* Destination byte exchange data expected result buffer */
static const uint8_t aDestByte_Exchange_ExpectedResult_Buffer[BUFFER_SIZE]      = {0xB1, 0xB0, 0xB3, 0xB2, 0xB5, 0xB4, 0xB7, 0xB6};

/* Destination half word exchange data expected result buffer */
static const uint8_t aDestHalfWord_Exchange_ExpectedResult_Buffer[BUFFER_SIZE]  = {0xB2, 0xB3, 0xB0, 0xB1, 0xB6, 0xB7, 0xB4, 0xB5};
/* USER CODE END PD */

DMA_HandleTypeDef handle_GPDMA1_Channel0;

void SystemClock_Config(void);
static void MX_GPDMA1_Init(void);
static void MX_ICACHE_Init(void);
/* USER CODE BEGIN PFP */
static void RightAlign_SignExtend_DMATransmit(void);
static void RightAlign_LeftTrunc_DMATransmit(void);
static void LeftAlign_RightTrunc_DMATransmit(void);
static void SrcByte_Exchange_DMATransmit(void);
static void DestByte_Exchange_DMATransmit(void);
static void DestHalfWord_Exchange_DMATransmit(void);

static void TransferComplete(DMA_HandleTypeDef *hdma);
static void TransferError(DMA_HandleTypeDef *hdma);
static uint16_t Buffercmp(uint8_t* pBuffer1, uint8_t* pBuffer2, uint16_t BufferLength);
/* USER CODE END PFP */

int main(void)
{

  /* USER CODE BEGIN 1 */
  /* STM32U3xx HAL library initialization:
       - Configure the Flash prefetch
       - Configure the Systick to generate an interrupt each 1 msec
       - Set NVIC Group Priority to 3
       - Low Level Initialization
     */
  /* USER CODE END 1 */

  /* MCU Configuration--------------------------------------------------------*/

  /* Reset of all peripherals, Initializes the Flash interface and the Systick. */
  HAL_Init();

  /* Configure the system clock */
  SystemClock_Config();

  /* USER CODE BEGIN SysInit */
  /* Initialize LD2 and LD2 : GREEN and RED leds */
  BSP_LED_Init(LD2);

  /* Clean destination buffer */
  memset((void *)aDEST_Buffer, 0U, BUFFER_SIZE * 2U);
  TransferCompleteDetected = 0U;
  TransferErrorDetected    = 0U;
  /* USER CODE END SysInit */

  /* Initialize all configured peripherals */
  MX_GPDMA1_Init();
  MX_ICACHE_Init();
  /* USER CODE BEGIN 2 */

  /* Select Callbacks functions called after Half Transfer Complete, Transfer Complete and Transfer Error */
  HAL_DMA_RegisterCallback(&handle_GPDMA1_Channel0, HAL_DMA_XFER_CPLT_CB_ID, TransferComplete);
  HAL_DMA_RegisterCallback(&handle_GPDMA1_Channel0, HAL_DMA_XFER_ERROR_CB_ID, TransferError);

  /* Configure the source, destination and buffer size DMA fields and Start DMA Channel/Stream transfer */
  /* Enable All the DMA interrupts */
  if (HAL_DMA_Start_IT(&handle_GPDMA1_Channel0, (uint32_t)&aSRC_Buffer, (uint32_t)&aDEST_Buffer, BUFFER_SIZE) != HAL_OK)
  {
    Error_Handler();
  }

  /* Wait for end of transmission or an error occurred */
  while ((TransferCompleteDetected == 0) && (TransferErrorDetected == 0U));

  /* Check DMA error */
  if (TransferErrorDetected == 1U)
  {
    Error_Handler();
  }

  /* Check destination buffer */
  if (Buffercmp((uint8_t*)aDEST_Buffer, (uint8_t*)aRightAlign_ZeroPadding_ExpectedResult_Buffer, BUFFER_SIZE * 2U) != 0U)
  {
    Error_Handler();
  }

  /* Clean destination buffer */
  memset((void *)aDEST_Buffer, 0U, BUFFER_SIZE * 2U);
  TransferCompleteDetected = 0U;
  TransferErrorDetected    = 0U;

  /*##-2- Right aligned / Sign extended data handling ########################*/
  RightAlign_SignExtend_DMATransmit();

  /* Wait for end of transmission or an error occurred */
  while ((TransferCompleteDetected == 0) && (TransferErrorDetected == 0U));

  /* Check DMA error */
  if (TransferErrorDetected == 1U)
  {
    Error_Handler();
  }

  /* Check destination buffer */
  if (Buffercmp((uint8_t*)aDEST_Buffer, (uint8_t*)aRightAlign_SignExtend_ExpectedResult_Buffer, BUFFER_SIZE * 2U) != 0U)
  {
    Error_Handler();
  }

  /* Clean destination buffer */
  memset((void *)aDEST_Buffer, 0U, BUFFER_SIZE * 2U);
  TransferCompleteDetected = 0U;
  TransferErrorDetected    = 0U;

  /*##-3- Right aligned / Left truncated data handling #######################*/
  RightAlign_LeftTrunc_DMATransmit();

  /* Wait for end of transmission or an error occurred */
  while ((TransferCompleteDetected == 0) && (TransferErrorDetected == 0U));

  /* Check DMA error */
  if (TransferErrorDetected == 1U)
  {
    Error_Handler();
  }

  /* Check destination buffer */
  if (Buffercmp((uint8_t*)aDEST_Buffer, (uint8_t*)aRightAlign_LeftTrunc_ExpectedResult_Buffer, BUFFER_SIZE) != 0U)
  {
    Error_Handler();
  }

  /* Clean destination buffer */
  memset((void *)aDEST_Buffer, 0U, BUFFER_SIZE);
  TransferCompleteDetected = 0U;
  TransferErrorDetected    = 0U;

  /*##-4- Left aligned / Right truncated data handling #######################*/
  LeftAlign_RightTrunc_DMATransmit();

  /* Wait for end of transmission or an error occurred */
  while ((TransferCompleteDetected == 0) && (TransferErrorDetected == 0U));

  /* Check DMA error */
  if (TransferErrorDetected == 1U)
  {
    Error_Handler();
  }

  /* Check destination buffer */
  if (Buffercmp((uint8_t*)aDEST_Buffer, (uint8_t*)aLeftAlign_RightTrunc_ExpectedResult_Buffer, BUFFER_SIZE) != 0U)
  {
    Error_Handler();
  }

  /* Clean destination buffer */
  memset((void *)aDEST_Buffer, 0U, BUFFER_SIZE);
  TransferCompleteDetected = 0U;
  TransferErrorDetected    = 0U;

  /*##-5- Source byte exchange data handling #################################*/
  SrcByte_Exchange_DMATransmit();

  /* Wait for end of transmission or an error occurred */
  while ((TransferCompleteDetected == 0) && (TransferErrorDetected == 0U));

  /* Check DMA error */
  if (TransferErrorDetected == 1U)
  {
    Error_Handler();
  }

  /* Check destination buffer */
  if (Buffercmp((uint8_t*)aDEST_Buffer, (uint8_t*)aSrcByte_Exchange_ExpectedResult_Buffer, BUFFER_SIZE) != 0U)
  {
    Error_Handler();
  }

  /* Clean destination buffer */
  memset((void *)aDEST_Buffer, 0U, BUFFER_SIZE);
  TransferCompleteDetected = 0U;
  TransferErrorDetected    = 0U;

  /*##-6- Destination byte exchange data handling #################################*/
  DestByte_Exchange_DMATransmit();

  /* Wait for end of transmission or an error occurred */
  while ((TransferCompleteDetected == 0) && (TransferErrorDetected == 0U));

  /* Check DMA error */
  if (TransferErrorDetected == 1U)
  {
    Error_Handler();
  }

  /* Check destination buffer */
  if (Buffercmp((uint8_t*)aDEST_Buffer, (uint8_t*)aDestByte_Exchange_ExpectedResult_Buffer, BUFFER_SIZE) != 0U)
  {
    Error_Handler();
  }

  /* Clean destination buffer */
  memset((void *)aDEST_Buffer, 0U, BUFFER_SIZE);
  TransferCompleteDetected = 0U;
  TransferErrorDetected    = 0U;

  /*##-7- Destination Half-Word exchange data handling #################################*/
  DestHalfWord_Exchange_DMATransmit();

  /* Wait for end of transmission or an error occurred */
  while ((TransferCompleteDetected == 0) && (TransferErrorDetected == 0U));

  /* Check DMA error */
  if (TransferErrorDetected == 1U)
  {
    Error_Handler();
  }

  /* Check destination buffer */
  if (Buffercmp((uint8_t*)aDEST_Buffer, (uint8_t*)aDestHalfWord_Exchange_ExpectedResult_Buffer, BUFFER_SIZE) != 0U)
  {
    Error_Handler();
  }
  /* USER CODE END 2 */

  /* Infinite loop */
  while (1)
  {

    /* USER CODE BEGIN 3 */
    HAL_Delay(250);
    BSP_LED_Toggle(LD2);
  }
  /* USER CODE END 3 */
}

void SystemClock_Config(void)
{
  RCC_OscInitTypeDef RCC_OscInitStruct = {0};
  RCC_ClkInitTypeDef RCC_ClkInitStruct = {0};

  /** Enable Epod Booster
  */
  if (HAL_RCCEx_EpodBoosterClkConfig(RCC_EPODBOOSTER_SOURCE_MSIS, RCC_EPODBOOSTER_DIV1) != HAL_OK)
  {
    Error_Handler();
  }

  if (HAL_PWREx_EnableEpodBooster() != HAL_OK)
  {
    Error_Handler();
  }

  /** Configure the main internal regulator output voltage
  */
  if (HAL_PWREx_ControlVoltageScaling(PWR_REGULATOR_VOLTAGE_SCALE1) != HAL_OK)
  {
    Error_Handler();
  }

  /** Set Flash latency before increasing MSIS
  */
  __HAL_FLASH_SET_LATENCY(FLASH_LATENCY_2);

  /** Initializes the CPU, AHB and APB buses clocks
  */
  RCC_OscInitStruct.OscillatorType = RCC_OSCILLATORTYPE_MSIS;
  RCC_OscInitStruct.MSISState = RCC_MSI_ON;
  RCC_OscInitStruct.MSISSource = RCC_MSI_RC0;
  RCC_OscInitStruct.MSISDiv = RCC_MSI_DIV1;
  if (HAL_RCC_OscConfig(&RCC_OscInitStruct) != HAL_OK)
  {
    Error_Handler();
  }

  /** Initializes the CPU, AHB and APB buses clocks
  */
  RCC_ClkInitStruct.ClockType = RCC_CLOCKTYPE_HCLK|RCC_CLOCKTYPE_SYSCLK
                              |RCC_CLOCKTYPE_PCLK1|RCC_CLOCKTYPE_PCLK2
                              |RCC_CLOCKTYPE_PCLK3;
  RCC_ClkInitStruct.SYSCLKSource = RCC_SYSCLKSOURCE_MSIS;
  RCC_ClkInitStruct.AHBCLKDivider = RCC_SYSCLK_DIV1;
  RCC_ClkInitStruct.APB1CLKDivider = RCC_HCLK_DIV1;
  RCC_ClkInitStruct.APB2CLKDivider = RCC_HCLK_DIV1;
  RCC_ClkInitStruct.APB3CLKDivider = RCC_HCLK_DIV1;

  if (HAL_RCC_ClockConfig(&RCC_ClkInitStruct, FLASH_LATENCY_2) != HAL_OK)
  {
    Error_Handler();
  }
}

static void MX_GPDMA1_Init(void)
{

  /* Peripheral clock enable */
  __HAL_RCC_GPDMA1_CLK_ENABLE();

  /* GPDMA1 interrupt Init */
    HAL_NVIC_SetPriority(GPDMA1_Channel0_IRQn, 0, 0);
    HAL_NVIC_EnableIRQ(GPDMA1_Channel0_IRQn);

  handle_GPDMA1_Channel0.Instance = GPDMA1_Channel0;
  handle_GPDMA1_Channel0.Init.Request = DMA_REQUEST_SW;
  handle_GPDMA1_Channel0.Init.BlkHWRequest = DMA_BREQ_SINGLE_BURST;
  handle_GPDMA1_Channel0.Init.Direction = DMA_MEMORY_TO_MEMORY;
  handle_GPDMA1_Channel0.Init.SrcInc = DMA_SINC_INCREMENTED;
  handle_GPDMA1_Channel0.Init.DestInc = DMA_DINC_INCREMENTED;
  handle_GPDMA1_Channel0.Init.SrcDataWidth = DMA_SRC_DATAWIDTH_BYTE;
  handle_GPDMA1_Channel0.Init.DestDataWidth = DMA_DEST_DATAWIDTH_HALFWORD;
  handle_GPDMA1_Channel0.Init.Priority = DMA_LOW_PRIORITY_HIGH_WEIGHT;
  handle_GPDMA1_Channel0.Init.SrcBurstLength = 1;
  handle_GPDMA1_Channel0.Init.DestBurstLength = 1;
  handle_GPDMA1_Channel0.Init.TransferAllocatedPort = DMA_SRC_ALLOCATED_PORT0|DMA_DEST_ALLOCATED_PORT1;
  handle_GPDMA1_Channel0.Init.TransferEventMode = DMA_TCEM_BLOCK_TRANSFER;
  handle_GPDMA1_Channel0.Init.Mode = DMA_NORMAL;
  if (HAL_DMA_Init(&handle_GPDMA1_Channel0) != HAL_OK)
  {
    Error_Handler();
  }
  if (HAL_DMA_ConfigChannelAttributes(&handle_GPDMA1_Channel0, DMA_CHANNEL_NPRIV) != HAL_OK)
  {
    Error_Handler();
  }

}

static void MX_ICACHE_Init(void)
{

  /** Enable instruction cache in 1-way (direct mapped cache)
  */
  if (HAL_ICACHE_ConfigAssociativityMode(ICACHE_1WAY) != HAL_OK)
  {
    Error_Handler();
  }
  if (HAL_ICACHE_Enable() != HAL_OK)
  {
    Error_Handler();
  }

}

/* USER CODE BEGIN 4 */
/**
  * @brief  Right aligned and sign extended data DMA transmit
  * @param  None
  * @retval None
  */
static void RightAlign_SignExtend_DMATransmit(void)
{
  DMA_DataHandlingConfTypeDef DataHandlingConfig = {0};

  /* Set DMA Instance */
  handle_GPDMA1_Channel0.Instance                    = GPDMA1_Channel0;

  /* Set parameter to be configured */
  handle_GPDMA1_Channel0.Init.Request                = DMA_REQUEST_SW;
  handle_GPDMA1_Channel0.Init.Direction              = DMA_MEMORY_TO_MEMORY;
  handle_GPDMA1_Channel0.Init.SrcInc                 = DMA_SINC_INCREMENTED;
  handle_GPDMA1_Channel0.Init.DestInc                = DMA_DINC_INCREMENTED;
  handle_GPDMA1_Channel0.Init.SrcDataWidth           = DMA_SRC_DATAWIDTH_BYTE;
  handle_GPDMA1_Channel0.Init.DestDataWidth          = DMA_DEST_DATAWIDTH_HALFWORD;
  handle_GPDMA1_Channel0.Init.SrcBurstLength         = 1;
  handle_GPDMA1_Channel0.Init.DestBurstLength        = 1;
  handle_GPDMA1_Channel0.Init.Priority               = DMA_LOW_PRIORITY_HIGH_WEIGHT;
  handle_GPDMA1_Channel0.Init.TransferEventMode      = DMA_TCEM_BLOCK_TRANSFER;
  handle_GPDMA1_Channel0.Init.TransferAllocatedPort  = DMA_SRC_ALLOCATED_PORT0 | DMA_DEST_ALLOCATED_PORT1;
  handle_GPDMA1_Channel0.Init.Mode                   = DMA_NORMAL;

  /* Initialize the DMA channel */
  if (HAL_DMA_Init(&handle_GPDMA1_Channel0) != HAL_OK)
  {
    Error_Handler();
  }

  /* Set data handling block configuration */
  DataHandlingConfig.DataExchange  = DMA_EXCHANGE_NONE;
  DataHandlingConfig.DataAlignment = DMA_DATA_RIGHTALIGN_SIGNEXT;

  /* Data handling configuration */
  if (HAL_DMAEx_ConfigDataHandling(&handle_GPDMA1_Channel0, &DataHandlingConfig) != HAL_OK)
  {
    while (1); /* KO */
  }

  /* Select Callbacks functions called after Half Transfer Complete, Transfer Complete and Transfer Error */
  HAL_DMA_RegisterCallback(&handle_GPDMA1_Channel0, HAL_DMA_XFER_CPLT_CB_ID, TransferComplete);
  HAL_DMA_RegisterCallback(&handle_GPDMA1_Channel0, HAL_DMA_XFER_ERROR_CB_ID, TransferError);

  /* Configure the source, destination and buffer size DMA fields and Start DMA Channel/Stream transfer */
  /* Enable All the DMA interrupts */
  if (HAL_DMA_Start_IT(&handle_GPDMA1_Channel0, (uint32_t)&aSRC_Buffer, (uint32_t)&aDEST_Buffer, BUFFER_SIZE) != HAL_OK)
  {
    Error_Handler();
  }
}

/**
  * @brief  Right aligned and left truncated data DMA transmit
  * @param  None
  * @retval None
  */
static void RightAlign_LeftTrunc_DMATransmit(void)
{
  DMA_DataHandlingConfTypeDef DataHandlingConfig = {0};

  /* Set DMA Instance */
  handle_GPDMA1_Channel0.Instance                    = GPDMA1_Channel0;

  /* Set parameter to be configured */
  handle_GPDMA1_Channel0.Init.Request                = DMA_REQUEST_SW;
  handle_GPDMA1_Channel0.Init.Direction              = DMA_MEMORY_TO_MEMORY;
  handle_GPDMA1_Channel0.Init.SrcInc                 = DMA_SINC_INCREMENTED;
  handle_GPDMA1_Channel0.Init.DestInc                = DMA_DINC_INCREMENTED;
  handle_GPDMA1_Channel0.Init.SrcDataWidth           = DMA_SRC_DATAWIDTH_HALFWORD;
  handle_GPDMA1_Channel0.Init.DestDataWidth          = DMA_DEST_DATAWIDTH_BYTE;
  handle_GPDMA1_Channel0.Init.SrcBurstLength         = 1;
  handle_GPDMA1_Channel0.Init.DestBurstLength        = 1;
  handle_GPDMA1_Channel0.Init.Priority               = DMA_LOW_PRIORITY_HIGH_WEIGHT;
  handle_GPDMA1_Channel0.Init.TransferEventMode      = DMA_TCEM_BLOCK_TRANSFER;
  handle_GPDMA1_Channel0.Init.TransferAllocatedPort  = DMA_SRC_ALLOCATED_PORT0 | DMA_DEST_ALLOCATED_PORT1;
  handle_GPDMA1_Channel0.Init.Mode                   = DMA_NORMAL;

  /* Initialize the DMA channel */
  if (HAL_DMA_Init(&handle_GPDMA1_Channel0) != HAL_OK)
  {
    Error_Handler();
  }

  /* Set data handling block configuration */
  DataHandlingConfig.DataExchange  = DMA_EXCHANGE_NONE;
  DataHandlingConfig.DataAlignment = DMA_DATA_RIGHTALIGN_LEFTTRUNC;

  /* Data handling configuration */
  if (HAL_DMAEx_ConfigDataHandling(&handle_GPDMA1_Channel0, &DataHandlingConfig) != HAL_OK)
  {
    while (1); /* KO */
  }

  /* Select Callbacks functions called after Half Transfer Complete, Transfer Complete and Transfer Error */
  HAL_DMA_RegisterCallback(&handle_GPDMA1_Channel0, HAL_DMA_XFER_CPLT_CB_ID, TransferComplete);
  HAL_DMA_RegisterCallback(&handle_GPDMA1_Channel0, HAL_DMA_XFER_ERROR_CB_ID, TransferError);

  /* Configure the source, destination and buffer size DMA fields and Start DMA Channel/Stream transfer */
  /* Enable All the DMA interrupts */
  if (HAL_DMA_Start_IT(&handle_GPDMA1_Channel0, (uint32_t)&aSRC_Buffer, (uint32_t)&aDEST_Buffer, BUFFER_SIZE) != HAL_OK)
  {
    Error_Handler();
  }
}

/**
  * @brief  Left aligned and right truncated data DMA transmit
  * @param  None
  * @retval None
  */
static void LeftAlign_RightTrunc_DMATransmit(void)
{
  DMA_DataHandlingConfTypeDef DataHandlingConfig = {0};

  /* Set DMA Instance */
  handle_GPDMA1_Channel0.Instance                    = GPDMA1_Channel0;

  /* Set parameter to be configured */
  handle_GPDMA1_Channel0.Init.Request                = DMA_REQUEST_SW;
  handle_GPDMA1_Channel0.Init.Direction              = DMA_MEMORY_TO_MEMORY;
  handle_GPDMA1_Channel0.Init.SrcInc                 = DMA_SINC_INCREMENTED;
  handle_GPDMA1_Channel0.Init.DestInc                = DMA_DINC_INCREMENTED;
  handle_GPDMA1_Channel0.Init.SrcDataWidth           = DMA_SRC_DATAWIDTH_HALFWORD;
  handle_GPDMA1_Channel0.Init.DestDataWidth          = DMA_DEST_DATAWIDTH_BYTE;
  handle_GPDMA1_Channel0.Init.SrcBurstLength         = 1;
  handle_GPDMA1_Channel0.Init.DestBurstLength        = 1;
  handle_GPDMA1_Channel0.Init.Priority               = DMA_LOW_PRIORITY_HIGH_WEIGHT;
  handle_GPDMA1_Channel0.Init.TransferEventMode      = DMA_TCEM_BLOCK_TRANSFER;
  handle_GPDMA1_Channel0.Init.TransferAllocatedPort  = DMA_SRC_ALLOCATED_PORT0 | DMA_DEST_ALLOCATED_PORT1;
  handle_GPDMA1_Channel0.Init.Mode                   = DMA_NORMAL;

  /* Initialize the DMA channel */
  if (HAL_DMA_Init(&handle_GPDMA1_Channel0) != HAL_OK)
  {
    Error_Handler();
  }

  /* Set data handling block configuration */
  DataHandlingConfig.DataExchange  = DMA_EXCHANGE_NONE;
  DataHandlingConfig.DataAlignment = DMA_DATA_LEFTALIGN_RIGHTTRUNC;

  /* Data handling configuration */
  if (HAL_DMAEx_ConfigDataHandling(&handle_GPDMA1_Channel0, &DataHandlingConfig) != HAL_OK)
  {
    while (1); /* KO */
  }

  /* Select Callbacks functions called after Half Transfer Complete, Transfer Complete and Transfer Error */
  HAL_DMA_RegisterCallback(&handle_GPDMA1_Channel0, HAL_DMA_XFER_CPLT_CB_ID, TransferComplete);
  HAL_DMA_RegisterCallback(&handle_GPDMA1_Channel0, HAL_DMA_XFER_ERROR_CB_ID, TransferError);

  /* Configure the source, destination and buffer size DMA fields and Start DMA Channel/Stream transfer */
  /* Enable All the DMA interrupts */
  if (HAL_DMA_Start_IT(&handle_GPDMA1_Channel0, (uint32_t)&aSRC_Buffer, (uint32_t)&aDEST_Buffer, BUFFER_SIZE) != HAL_OK)
  {
    Error_Handler();
  }
}

/**
  * @brief  Source byte exchange data DMA transmit
  * @param  None
  * @retval None
  */
static void SrcByte_Exchange_DMATransmit(void)
{
  DMA_DataHandlingConfTypeDef DataHandlingConfig = {0};

  /* Set DMA Instance */
  handle_GPDMA1_Channel0.Instance                    = GPDMA1_Channel0;

  /* Set parameter to be configured */
  handle_GPDMA1_Channel0.Init.Request                = DMA_REQUEST_SW;
  handle_GPDMA1_Channel0.Init.Direction              = DMA_MEMORY_TO_MEMORY;
  handle_GPDMA1_Channel0.Init.SrcInc                 = DMA_SINC_INCREMENTED;
  handle_GPDMA1_Channel0.Init.DestInc                = DMA_DINC_INCREMENTED;
  handle_GPDMA1_Channel0.Init.SrcDataWidth           = DMA_SRC_DATAWIDTH_WORD;
  handle_GPDMA1_Channel0.Init.DestDataWidth          = DMA_DEST_DATAWIDTH_WORD;
  handle_GPDMA1_Channel0.Init.SrcBurstLength         = 1;
  handle_GPDMA1_Channel0.Init.DestBurstLength        = 1;
  handle_GPDMA1_Channel0.Init.Priority               = DMA_LOW_PRIORITY_HIGH_WEIGHT;
  handle_GPDMA1_Channel0.Init.TransferEventMode      = DMA_TCEM_BLOCK_TRANSFER;
  handle_GPDMA1_Channel0.Init.TransferAllocatedPort  = DMA_SRC_ALLOCATED_PORT0 | DMA_DEST_ALLOCATED_PORT1;
  handle_GPDMA1_Channel0.Init.Mode                   = DMA_NORMAL;

  /* Initialize the DMA channel */
  if (HAL_DMA_Init(&handle_GPDMA1_Channel0) != HAL_OK)
  {
    Error_Handler();
  }

  /* Set data handling block configuration */
  DataHandlingConfig.DataExchange  = DMA_EXCHANGE_SRC_BYTE;
  DataHandlingConfig.DataAlignment = DMA_DATA_RIGHTALIGN_ZEROPADDED;

  /* Data handling configuration */
  if (HAL_DMAEx_ConfigDataHandling(&handle_GPDMA1_Channel0, &DataHandlingConfig) != HAL_OK)
  {
    while (1); /* KO */
  }

  /* Select Callbacks functions called after Half Transfer Complete, Transfer Complete and Transfer Error */
  HAL_DMA_RegisterCallback(&handle_GPDMA1_Channel0, HAL_DMA_XFER_CPLT_CB_ID, TransferComplete);
  HAL_DMA_RegisterCallback(&handle_GPDMA1_Channel0, HAL_DMA_XFER_ERROR_CB_ID, TransferError);

  /* Configure the source, destination and buffer size DMA fields and Start DMA Channel/Stream transfer */
  /* Enable All the DMA interrupts */
  if (HAL_DMA_Start_IT(&handle_GPDMA1_Channel0, (uint32_t)&aSRC_Buffer, (uint32_t)&aDEST_Buffer, BUFFER_SIZE) != HAL_OK)
  {
    Error_Handler();
  }
}

/**
  * @brief  Destination byte exchange data DMA transmit
  * @param  None
  * @retval None
  */
static void DestByte_Exchange_DMATransmit(void)
{
  DMA_DataHandlingConfTypeDef DataHandlingConfig = {0};

  /* Set DMA Instance */
  handle_GPDMA1_Channel0.Instance                    = GPDMA1_Channel0;

  /* Set parameter to be configured */
  handle_GPDMA1_Channel0.Init.Request                = DMA_REQUEST_SW;
  handle_GPDMA1_Channel0.Init.Direction              = DMA_MEMORY_TO_MEMORY;
  handle_GPDMA1_Channel0.Init.SrcInc                 = DMA_SINC_INCREMENTED;
  handle_GPDMA1_Channel0.Init.DestInc                = DMA_DINC_INCREMENTED;
  handle_GPDMA1_Channel0.Init.SrcDataWidth           = DMA_SRC_DATAWIDTH_WORD;
  handle_GPDMA1_Channel0.Init.DestDataWidth          = DMA_DEST_DATAWIDTH_WORD;
  handle_GPDMA1_Channel0.Init.SrcBurstLength         = 1;
  handle_GPDMA1_Channel0.Init.DestBurstLength        = 1;
  handle_GPDMA1_Channel0.Init.Priority               = DMA_LOW_PRIORITY_HIGH_WEIGHT;
  handle_GPDMA1_Channel0.Init.TransferEventMode      = DMA_TCEM_BLOCK_TRANSFER;
  handle_GPDMA1_Channel0.Init.Mode                   = DMA_NORMAL;

  /* Initialize the DMA channel */
  if (HAL_DMA_Init(&handle_GPDMA1_Channel0) != HAL_OK)
  {
    Error_Handler();
  }

  /* Set data handling block configuration */
  DataHandlingConfig.DataExchange  = DMA_EXCHANGE_DEST_BYTE;
  DataHandlingConfig.DataAlignment = DMA_DATA_RIGHTALIGN_ZEROPADDED;

  /* Data handling configuration */
  if (HAL_DMAEx_ConfigDataHandling(&handle_GPDMA1_Channel0, &DataHandlingConfig) != HAL_OK)
  {
    while (1); /* KO */
  }

  /* Select Callbacks functions called after Half Transfer Complete, Transfer Complete and Transfer Error */
  HAL_DMA_RegisterCallback(&handle_GPDMA1_Channel0, HAL_DMA_XFER_CPLT_CB_ID, TransferComplete);
  HAL_DMA_RegisterCallback(&handle_GPDMA1_Channel0, HAL_DMA_XFER_ERROR_CB_ID, TransferError);

  /* Configure the source, destination and buffer size DMA fields and Start DMA Channel/Stream transfer */
  /* Enable All the DMA interrupts */
  if (HAL_DMA_Start_IT(&handle_GPDMA1_Channel0, (uint32_t)&aSRC_Buffer, (uint32_t)&aDEST_Buffer, BUFFER_SIZE) != HAL_OK)
  {
    Error_Handler();
  }
}

/**
  * @brief  Destination half word exchange data DMA transmit
  * @param  None
  * @retval None
  */
static void DestHalfWord_Exchange_DMATransmit(void)
{
  DMA_DataHandlingConfTypeDef DataHandlingConfig = {0};

  /* Set DMA Instance */
  handle_GPDMA1_Channel0.Instance                    = GPDMA1_Channel0;

  /* Set parameter to be configured */
  handle_GPDMA1_Channel0.Init.Request                = DMA_REQUEST_SW;
  handle_GPDMA1_Channel0.Init.Direction              = DMA_MEMORY_TO_MEMORY;
  handle_GPDMA1_Channel0.Init.SrcInc                 = DMA_SINC_INCREMENTED;
  handle_GPDMA1_Channel0.Init.DestInc                = DMA_DINC_INCREMENTED;
  handle_GPDMA1_Channel0.Init.SrcDataWidth           = DMA_SRC_DATAWIDTH_WORD;
  handle_GPDMA1_Channel0.Init.DestDataWidth          = DMA_DEST_DATAWIDTH_WORD;
  handle_GPDMA1_Channel0.Init.SrcBurstLength         = 1;
  handle_GPDMA1_Channel0.Init.DestBurstLength        = 1;
  handle_GPDMA1_Channel0.Init.Priority               = DMA_LOW_PRIORITY_HIGH_WEIGHT;
  handle_GPDMA1_Channel0.Init.TransferEventMode      = DMA_TCEM_BLOCK_TRANSFER;
  handle_GPDMA1_Channel0.Init.Mode                   = DMA_NORMAL;

  /* Initialize the DMA channel */
  if (HAL_DMA_Init(&handle_GPDMA1_Channel0) != HAL_OK)
  {
    Error_Handler();
  }

  /* Set data handling block configuration */
  DataHandlingConfig.DataExchange  = DMA_EXCHANGE_DEST_HALFWORD;
  DataHandlingConfig.DataAlignment = DMA_DATA_RIGHTALIGN_ZEROPADDED;

  /* Data handling configuration */
  if (HAL_DMAEx_ConfigDataHandling(&handle_GPDMA1_Channel0, &DataHandlingConfig) != HAL_OK)
  {
    while (1); /* KO */
  }

  /* Select Callbacks functions called after Half Transfer Complete, Transfer Complete and Transfer Error */
  HAL_DMA_RegisterCallback(&handle_GPDMA1_Channel0, HAL_DMA_XFER_CPLT_CB_ID, TransferComplete);
  HAL_DMA_RegisterCallback(&handle_GPDMA1_Channel0, HAL_DMA_XFER_ERROR_CB_ID, TransferError);

  /* Configure the source, destination and buffer size DMA fields and Start DMA Channel/Stream transfer */
  /* Enable All the DMA interrupts */
  if (HAL_DMA_Start_IT(&handle_GPDMA1_Channel0, (uint32_t)&aSRC_Buffer, (uint32_t)&aDEST_Buffer, BUFFER_SIZE) != HAL_OK)
  {
    Error_Handler();
  }
}

/**
  * @brief  DMA transfer complete callback
  * @note   This function is executed when the transfer complete interrupt
  *         is generated
  * @retval None
  */
static void TransferComplete(DMA_HandleTypeDef *hdma)
{
  TransferCompleteDetected = 1U;
}

/**
  * @brief  DMA transfer error callback
  * @note   This function is executed when the transfer error interrupt
  *         is generated during DMA transfer
  * @retval None
  */
static void TransferError(DMA_HandleTypeDef *hdma)
{
  TransferErrorDetected = 1U;
}

/**
  * @brief  Compares two buffers.
  * @param  pBuffer1, pBuffer2: buffers to be compared.
  * @param  BufferLength: buffer's length
  * @retval 0   : pBuffer1 identical to pBuffer2
  *         > 0 : pBuffer1 differs from pBuffer2
  */
static uint16_t Buffercmp(uint8_t* pBuffer1, uint8_t* pBuffer2, uint16_t BufferLength)
{
  while (BufferLength--)
  {
    if ((*pBuffer1) != *pBuffer2)
    {
      return BufferLength;
    }

    pBuffer1++;
    pBuffer2++;
  }

  return 0;
}
/* USER CODE END 4 */

void Error_Handler(void)
{
  /* USER CODE BEGIN Error_Handler_Debug */
  /* User can add his own implementation to report the HAL error return state */
  /* Turn LD2 on */
  BSP_LED_On(LD2);
  __disable_irq();
  while (1)
  {
  }
  /* USER CODE END Error_Handler_Debug */
}
